## aa_wireless_dongle/package/aawg/Config.in
```kconfig
config BR2_PACKAGE_AAWG
	bool "aawg"
	depends on BR2_PACKAGE_PYTHON3
	select BR2_PACKAGE_PYTHON_DBUS
	select BR2_PACKAGE_PYTHON_GOBJECT
	select BR2_PACKAGE_PYTHON_PROTOBUF
	select BR2_PACKAGE_HOST_PYTHON_PROTOBUF
	help
	  Android Auto Wireless Gateway Daemon (Python Implementation)
	  
	  A Python-based implementation of the wireless Android Auto
	  adapter that enables wireless Android Auto functionality
	  in cars that only support wired connections.
```
